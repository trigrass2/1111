/*
 * CAUTION: This file is automatically generated by Xilinx.
 * Version: XSCT 2018.3
 * Today is: Thu Jun 18 10:42:37 2020
 */


/dts-v1/;
#include "zynq-7000.dtsi"
#include "pl.dtsi"
#include "pcw.dtsi"
/ {
	chosen {
		bootargs = "earlycon";
		stdout-path = "serial0:115200n8";
	};
	aliases {
		i2c0 = &axi_iic_0;
		i2c1 = &axi_iic_1;
		i2c2 = &axi_iic_2;
		i2c3 = &i2c0;
		serial0 = &axi_uart16550_0;
		serial1 = &axi_uart16550_1;
		serial10 = &axi_uart16550_8;
		serial11 = &axi_uart16550_9;
		serial12 = &uart0;
		serial13 = &uart1;
		serial2 = &axi_uart16550_10;
		serial3 = &axi_uart16550_11;
		serial4 = &axi_uart16550_2;
		serial5 = &axi_uart16550_3;
		serial6 = &axi_uart16550_4;
		serial7 = &axi_uart16550_5;
		serial8 = &axi_uart16550_6;
		serial9 = &axi_uart16550_7;
		spi0 = &qspi;
		spi1 = &spi0;
		spi2 = &spi1;
	};
	memory {
		device_type = "memory";
		reg = <0x0 0x40000000>;
	};
};
